// SPDX-License-Identifier: GPL-2.0+
/*
 * Copyright 2023 Gateworks Corporation
 */

#include "imx8mp-venice-u-boot.dtsi"

&ethphy0 {
	reset-gpios = <&gpio3 14 GPIO_ACTIVE_LOW>;
	reset-assert-us = <1000>;
	resert-deassert-us = <300000>;
};

